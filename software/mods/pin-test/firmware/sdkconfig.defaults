## software/mods/pin-test/firmware/sdkconfig.defaults
```kconfig
# ── Target ──────────────────────────────────────────────────────────────────
CONFIG_IDF_TARGET="esp32s3"

# ── Arduino-as-component: auto-run setup()/loop(); Serial on UART0 (CH340C) ──
CONFIG_AUTOSTART_ARDUINO=y
CONFIG_FREERTOS_HZ=1000

# ── 8 MB flash, QIO mode ──────────────────────────────────────────────────────
CONFIG_ESPTOOLPY_FLASHSIZE_8MB=y
CONFIG_ESPTOOLPY_FLASHMODE_QIO=y
```
